## config/west.yml
```yaml
manifest:
  remotes:
    - name: mouseftc
      url-base: https://github.com/ftc
  projects:
    - name: zmk
      remote: mouseftc
      revision: mouse-ftc
      import: app/west.yml
  self:
    path: config
```
